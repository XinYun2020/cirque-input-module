## drivers/input/Kconfig
```kconfig
# Copyright (c) 2022 The ZMK Contributors
# SPDX-License-Identifier: MIT

menuconfig INPUT_PINNACLE
    bool "Cirque Pinnacle trackpads"
    default y
    depends on GPIO
    depends on SPI || I2C
    depends on INPUT
    depends on DT_HAS_CIRQUE_PINNACLE_ENABLED
    help
      Enable driver for Cirque Pinnacle trackpads

if INPUT_PINNACLE

config INPUT_PINNACLE_INIT_PRIORITY
    int "Cirque Pinnacle initialization priority"
    default INPUT_INIT_PRIORITY

if ZMK_MOUSE

config ZMK_INPUT_PINNACLE_IDLE_SLEEPER
    bool "Pinnacle Sleep linked to ZMK idle state"
    default n

endif

endif

/* FIXME */

# Copyright (c) 2025 Your Name
# SPDX-License-Identifier: Apache-2.0

config CIRQUE_GLIDEPOINT
	bool "Cirque GlidePoint touchpad input driver"
	default y
	depends on DT_HAS_CIRQUE_GLIDEPOINT_I2C_ENABLED
	select I2C
	help
	  Enable driver for Cirque GlidePoint touchpad sensor with
	  mouse-like relative input events.

if CIRQUE_GLIDEPOINT

config CIRQUE_GLIDEPOINT_LOG_LEVEL
	int "Cirque GlidePoint driver log level"
	depends on LOG
	default 1
	help
	  Sets log level for Cirque GlidePoint driver.
	  
	  Levels are:
	  - 0 OFF, do not write
	  - 1 ERROR, only write LOG_ERR
	  - 2 WARNING, write LOG_WRN in addition to previous level
	  - 3 INFO, write LOG_INF in addition to previous levels
	  - 4 DEBUG, write LOG_DBG in addition to previous levels

config CIRQUE_GLIDEPOINT_CIRCULAR_SCROLL
	bool "Enable circular scrolling on edges of touchpad"
	default y
	help
	  Enables circular scrolling when moving finger in a circular
	  motion around the edge of the touchpad.

config CIRQUE_GLIDEPOINT_SIGMOID_ACCEL
	bool "Enable sigmoid acceleration for cursor movement"
	default y
	help
	  Enables advanced sigmoid-based pointer acceleration for
	  more precise cursor control.

endif # CIRQUE_GLIDEPOINT
```

## dts/bindings/input/cirque,pinnacle-common.yaml
```yaml
properties:
  dr-gpios:
    type: phandle-array
    description: Data ready pin for the trackpad
  rotate-90:
    type: boolean
  x-invert:
    type: boolean
  y-invert:
    type: boolean
  sleep:
    type: boolean
  no-secondary-tap:
    type: boolean
  no-taps:
    type: boolean
  sensitivity:
    type: string
    enum:
      - 1x
      - 2x
      - 3x
      - 4x
    description: ADC attenuation (sensitivity) setting.
  x-axis-z-min:
    type: int
    default: 5
  y-axis-z-min:
    type: int
    default: 4
  # for sigmoid acceleration
  sigmoid-acceleration:
    type: boolean
    description: Enable sigmoid acceleration for cursor movement
  acceleration-factor:
    type: double
    default: 2.0
    description: Multiplier for sigmoid acceleration curve
  acceleration-threshold:
    type: double
    default: 5.0
    description: Movement threshold to start accelerating
  # for circular scrolling
  circular-scroll:
    type: boolean
    description: Enable circular scrolling functionality
  circular-scroll-radius:
    type: int
    default: 20
    description: Minimum radius to activate circular scroll (in relative units)
  circular-scroll-deadzone:
    type: int
    default: 4
    description: Angular deadzone to prevent accidental scrolling (in degrees)
  circular-scroll-deadzone-radius:
    type: int
    default: 15
    description: Center deadzone radius for circular scrolling (in mm)
  circular-scroll-direction:
    type: int
    default: 0
    enum:
      - 0
      - 1
    description: Direction of scrolling (0=normal, 1=inverted)
  # for circular scroll key mapping
  circular-scroll-key-mode:
    type: boolean
    default: false
    description: When true, send key events instead of scroll events
  circular-scroll-key-clockwise:
    type: int
    default: 0
    description: Key code to send when circular scrolling clockwise
  circular-scroll-key-counterclockwise:
    type: int
    default: 0
    description: Key code to send when circular scrolling counterclockwise
```

## dts/bindings/input/cirque,pinnacle-i2c.yaml
```yaml
description: |
  Sensor driver for the Cirque Pinnacle trackpad ASICs, using the I2C interface

compatible: "cirque,pinnacle"

include: ["i2c-device.yaml", "cirque,pinnacle-common.yaml"]

properties:
  reg:
    required: true
    
  irq-gpios:
    type: phandle-array
    required: true
    description: |
      Interrupt pin.
      
      The interrupt pin of GlidePoint is active-low.

  circular-scroll-radius:
    type: int
    default: 40
    description: |
      Radius threshold in pixels to activate circular scrolling.
      
      A larger value requires moving further from the initial touch
      point to activate the circular scrolling mode.
      
  circular-scroll-deadzone:
    type: int
    default: 10
    description: |
      Inner deadzone radius in pixels to prevent accidental activation
      of circular scrolling.
```
